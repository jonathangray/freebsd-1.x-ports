.nr H1 1
.H 1 "Installation Information"
.\"
.\"	Developer
.\"
This chapter lists supplemental information to 
the \f2IRIS Software Installation Guide.\f1
The information listed here is product-specific;
use it with the Installation Guide to install 
this product.
.H 2 "FlexFAX Subsystems"
..\"
.\" Each subsystem should be described in enough detail so that
.\" users can decide whether or not they need to install it.
.\" Hints such as "You need to install this subsystem if you want to use
.\" Visual System Administration Tools" or "This subsystem is useful only
.\" if you want to display Kanji characters" would be nice. For subsystems
.\" such as eoe2.sw.4Dwm that are important if you have graphics, but not 
.\" important for servers and aren't marked required in the spec file (inst 
.\" doesn't show + and doesn't require their installation), be sure to make
.\" this very clear in the description or in a separate list.
.\"
The FlexFAX software includes these subsystems:
.VL 30
.LI "\f2flexfax.sw.client\f1"
Software for sending facsimile and
querying the status of FlexFAX servers.
.LI "\f2flexfax.man.client\f1"
Manual pages for client programs.
.LI "\f2flexfax.sw.server\f1"
Software for running a FlexFAX server.
.LI "\f2flexfax.man.readme\f1"
Basic information about the system, including setup and maintenance.
.LI "\f2flexfax.man.server\f1"
Manual pages for the server software.
.LI "\f2flexfax.man.relnotes\f1"
Release notes (this document)
.LI "\f2flexfax.man.doc\f1"
Miscellaneous supporting documentation,
including a paper describing the
original system architecture (now very out of date).
.LE
.H 2 "FlexFAX Subsystem Disk Space Requirements"
.\"
.\" The size of each subsystem should be listed so that users get an idea
.\" of the disk space requirements before they get into inst.
.\"
This section lists the subsystems (and their sizes) of the FlexFAX option.
.P
Those marked ``default'' are the default subsystems.
If you are installing this option for the first time,
these are the subsystems that are installed if you
use the ``go'' menu item.
To install a different set of subsystems, use 
the ``install,'' ``remove,'' ``keep,'' and ``step'' commands 
in \f2inst\f1 to customize the list of subsystems to be
installed, then select the ``go'' menu item.
.VL 7
.LI "\f6Note:\f1"
The listed subsystem sizes are approximate. 
Refer to the 
\f2IRIS Software Installation Guide\f1
for information on finding exact sizes.
.LE
.ps 9
.vs 11
.TS
tab(:);
lw(2.75i):lw(1.5i)
lw(2.75i):lw(1.5i)
lIw(2.75i):nw(1.5i).
\f6Subsystem Name:Subsystem Size
:\f6(kilobytes)\f1
.ps 10
.vs 12
.sp 0.3
flexfax.sw.client:\f11786
.br
\f1(default)\fP
.sp 0.3
flexfax.sw.server:\f12464
.sp 0.3
flexfax.man.client:\f138
.br
\f1(default)\fP
.sp 0.3
flexfax.man.server:\f181
.sp 0.3
flexfax.man.readme:\f146
.br
\f1(default)\fP
.sp 0.3
flexfax.man.relnotes:\f121
.br
\f1(default)\fP
.sp 0.3
flexfax.man.doc:\f181
.TE
.ps 11
.vs 13
.H 2 "Installation Method"
All of the subsystems for FlexFAX can be installed using IRIX.
You do not need to use the miniroot. Refer to the \f2IRIS Software 
Installation Guide\f1 for complete installation instructions.
.ps 10
.vs 12
.H 2 "Prerequisites"
.\"
.\" Delete this section if it does not apply.
.\"
.\" Every prerequisite of every subsystem should be listed whether it's in
.\" spec file or not. Be sure to include specific release numbers when
.\" the prerequisite is a subsystem in a different product.  If there are
.\" many prerequisites, you might want to list them in a table. 
.\"
.\" Examples of prerequisite information are:
.\"
If you want to install flexfax.sw.server, you must also install
dps_eoe.sw.dps and dps_eoe.sw.dpsfonts.
.\" If you want to install a.b.c, release n.0 or later of x.y.z must be
.\" installed.
Your workstation must be running at least release 4D1-4.0.1 in order to
use version 2.1 of this software.
.\"
.H 2 "Configuration Files"
.\"
.\" Delete this section if it does not apply.
.\"
.\" List the configuration files in your product.  Tell what their purpose
.\" is and give users some idea of how and why they might want to modify them.
.\" You should also discuss each of the changes made in each of the 
.\" configuration files for this release to make the process of merging
.\" local changes with SGI changes easier for users.
.\"
.fp 4 HD
This section lists installed files that can be edited to contain
site-specific changes.
Please see the server manual pages for complete details.
.P
The following configuration files determine if one or more
facsimile server processes are started during system initialization.
The facsimile system is enabled if the configuration flag
in the\f2/etc/config\fP directory is in the ``on'' state.
Use the \f2chkconfig\fP(1M) command to turn a flag on or off.
.VL 30
.LI "\f2/etc/config/fax\fP"
Start a \f2faxd\fP(1M) process for each configured modem.
.LE
.P
Change the following files to reflect your site's setup:
.VL 30
.LI "\f2/usr/spool/fax/etc/config.\fPdev"
The configuration file for the /dev/\f2dev\fP modem device.
This file contains information such as the phone number associated
with the modem, and whether or not the server should permit
incoming data connections.
Consult \f2faxaddmodem\fP(4F) and
\f2config\fP(4F) for complete information.
.LI "\f2/usr/spool/fax/FIFO.\fPdev"
This is a FIFO special file that must exist for each modem device
attached to a host.
The file is normally create with mode 600 and owned by user ``uucp''.
The system startup script will create a fax server process for
each device that has both a configuration file and a FIFO
special device file.
The installation procedure for a server uses the
\f2faxaddmodem\fP(4F) script to setup this file and
the configuration file.
.LE
.P
The following shell command files may be modified
to suit site-specific needs:
.VL 30
.LI "\f2/usr/local/lib/fax/typerules\fP"
A set of rules that specify how to convert a file submitted for
transmission to a format supported by the facsimile server (PostScript
or TIFF).
Consult \f2typerules\fP(4F) for a description of this file.
.LI "\f2/usr/local/lib/fax/faxcover.ps\fP"
A stylized PostScript document that is used
when creating cover pages for outgoing facsimile.
See the \f2faxcover\fP(1) program for details on the format.
.LI "\f2/usr/spool/fax/bin/deliver\fP"
A shell script that is used by the server to deliver a TIFF facsimile
document by electronic mail.
.LI "\f2/usr/spool/fax/bin/notify\fP"
The shell script that is invoked by the server when a facsimile
is received.
The default script sends electronic mail to the ``FaxMaster'' user.
.LI "\f2/usr/spool/fax/bin/ps2fax\fP"
The shell script that is used by the server to convert a PostScript document
to a TIFF document for transmission.
The default script invokes a Display PostScript-based imaging program.
This file is usually a link to either /usr/spool/fax/bin/ps2fax.dps 
or /usr/spool/fax/bin/ps2fax.gs.
.LE
.H 2 "Other Installation Information"
Note that you need a fax modem to use this software.
Fax modems are not the same as data modems,
though many of contemporary fax modems also
function well as data modems.
The following specific
modems are known to work with this release (though some perform
better than others).
(If you are unfamiliar with the terminology used in the following
description, refer to the document
\f2/usr/local/doc/flexfax/modems-faq\fP.)
.VL 24
.LI "Abaton InterFax 24/96"
A modem commonly found on Macintosh systems and actually made by Everex.
There were two versions:
one suported at best 4800 bit/sec Group 3 facsimile
communication, while the other supported 9600 bit/sec.
Both provide 1200/2400 baud data communication.
.sp .5
\f3NB: support for this driver is temporarily broken.\fP
.LI "Boca M1440E"
(Firmware revision V1.270 or newer.)
A Class 2 modem that supports v.27, v.29, and v.17
facsimile and v.32bis and v.42bis data communication.
The modem is based on the Rockwell RC144AC.
.LI "Dallas Fax"
A Class 2 modem that uses Rockwell parts.
The modem supports v.27, v.29, and v.17 for facsimile with v.32bis
and v.42bis for data.
This modem is no longer sold (the manufacturer is out of business).
.LI "Digicom Scout+"
(Firmware revision 2A19/2931 or newer.)
A Class 1 modem based on DSP parts and proprietary firmware.
The modem supports v.27 and v.29 facsimile with v.32bis
and v.43bis for for data communication.
.LI "Everex 24/96D"
One of the first Class 2 modems.
The modem is the same as the Abaton modem, but with Class 2
firmware and more DRAM.
The modem supports v.27 and v.29 for facsimile
and 1200/2400 baud data communication.
.LI "Hayes Optima 24+Fax96"
(Firmware revision TR00-J260-001 XXX or newer.)
A Class 2 modem based on the Rockwell RC9624AC.
Supports v.27 and v.29 for facsimile and 1200/2400 baud data
communication.
Experiences with this modem have not been good.
.LI "Multi-Tech 1432BAI"
(Firmware revision 0307 I or newer.)
A Class 2 modem that supports v.27, v.29 and v.17 for
facsimile and v.32bis and v.42bis for data communication.
The modem is based on the AT&T chip set and custom firmware.
.LI "Nuvo Voyager 96424PFX"
(Firmware revision AF-C2500-E0.)
A Class 1 pocket modem that supports v.27 and v.29, 9600 baud
sending, but only 4800 baud receiving.
Based on the Rockwell RC224A.
.LI "SupraFAX V.32bis"
(Firmware revision V1.200-C or newer.)
A Class 2 modem that is based on the Rockwell RC144AC.
The modem supports v.27, v.29, and v.17 for facsimile
and v.32bis and v.42bis for data communication.
.LI "Telebit WorldBlazer"
(Firmware revision LA7.01 or newer.)
A Class 2 modem that supports v.27 and v.29 for facsimile
and a variety of data communication protocols including
v.32bis and v.42bis.
.LI "Twincom 144/DF"
(Firmware revision V1.200 or newer.)
A Class 2 modem that is based on the Rockwell RC144AC.
The modem upports v.27, v.29 and v.17
facsimile protocols and v.32bis and v.42bis data protocols.
.LI "ZyXel U1496E"
(Note you must have firmware revision 5.01 or newer.)
A Class 2 modem based on DSP parts and proprietary firmware.
The modem supports v.27, v.29, and v.17
for facsimile and v.32bis and v.42bis for data communication.
The firmware for this modem tends to change frequently.
As of revision 6.00 the Class 2 facsimile support is still
not fully functional; see "Known Problems and Workarounds".
.LE
.P
Note that this software tries to support any facsimile modem
that provides either the
Telecommunications Industry Associate (TIA)
Standards Proposal No. 2388-A of August 30, 1991--so called
``\f2Class 2\fP-style modems''--or the
Telecommunications Industry Associate (TIA)
Standard 578 of October 22, 1990--so called
``\f2Class 1\fP-style modems''.
The software has been tried with the modems and firmware listed above.
Other modems that claim to conform to the Class 1 or
Class 2 specification may also work but there are no guarantees.
